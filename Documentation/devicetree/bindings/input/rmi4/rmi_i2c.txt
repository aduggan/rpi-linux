## Documentation/devicetree/bindings/input/rmi4/rmi_i2c.txt
```
Synaptics RMI4 I2C Device Binding

The Synaptics RMI4 core is able to support RMI4 devices using differnet
transports and differnet functions. This file describes the device tree
bindings for devices using the I2C tranport driver. Complete documentation
for other transports and functions cen be found ini
Documentation/devicetree/bindings/input/rmi4.

Required Properties:
- compatible: syna,rmi-i2c
- reg: I2C address

Optional Properties:
- interrupts: interrupt which the rmi device is connected to.
- interrupt-parent: The interrupt controller.
See Documentation/devicetree/bindings/interrupt-controller/interrupts.txt

- syna,sensor-name: The string containing the name of the sensor.
- syna,poll-interval-ms: The interval in milliseconds to wait between reading
			interrupts when the driver is polling.
- syna,reset-delay-ms: The number of milliseconds to wait after resetting the
			device.

Function Parameters:
Parameters specific to RMI functions are contained in child nodes of the rmi device
 node. Documentation for the parameters of each function can be found in:
Documentation/devicetree/bindings/input/rmi4/rmi_f*.txt.



Example:
	&i2c1 {
		rmi-i2c-dev@2c {
			compatible = "syna,rmi-i2c";
			reg = <0x2c>;
			interrupt-parent = <&gpio>;
			interrupts = <4 2>;
			syna,sensor-name="TM1949";

			rmi-f01@1 {
				reg = <0x1>;
				syna,f01-nosleep = <1>;
			};

			rmi-f11@11 {
				reg = <0x11>;
				syna,f11-flip-y = <1>;
				syna,f11-sensor-type = <2>;
			};
		};
	};
```

## Documentation/devicetree/bindings/input/rmi4/rmi_spi.txt
```
Synaptics RMI4 SPI Device Binding

The Synaptics RMI4 core is able to support RMI4 devices using differnet
transports and differnet functions. This file describes the device tree
bindings for devices using the SPI tranport driver. Complete documentation
for other transports and functions cen be found ini
Documentation/devicetree/bindings/input/rmi4.

Required Properties:
- compatible: syna,rmi-spi
- reg: Chip select address for the device

Optional Properties:
- interrupts: interrupt which the rmi device is connected to.
- interrupt-parent: The interrupt controller.
See Documentation/devicetree/bindings/interrupt-controller/interrupts.txt

- syna,sensor-name: The string containing the name of the sensor.
- syna,spi-read-delay: millisecond delay between read byte transfers.
- syna,spi-write-delay: millisecond delay between write byte transfers.

Function Parameters:
Parameters specific to RMI functions are contained in child nodes of the rmi device
 node. Documentation for the parameters of each function can be found in:
Documentation/devicetree/bindings/input/rmi4/rmi_f*.txt.



Example:
	spi@7000d800 {
		rmi-spi-dev@0 {
                        compatible = "syna,rmi-spi";
                        reg = <0x0>;
                        spi-max-frequency = <4000000>;
                        spi-cpha;
                        spi-cpol;
                        interrupt-parent = <&gpio>;
                        interrupts = <TEGRA_GPIO(K, 2) 0x2>;
                        syna,spi-read-delay = <30>;

			rmi-f01@1 {
				reg = <0x1>;
				syna,f01-nosleep = <1>;
			};

			rmi-f11@11 {
				reg = <0x11>;
				syna,f11-flip-y = <1>;
				syna,f11-sensor-type = <2>;
			};
		};
	};
```

## drivers/input/rmi4/Kconfig
```kconfig
#
# RMI4 configuration
#
config RMI4_CORE
	tristate "Synaptics RMI4 bus support"
	help
	  Say Y here if you want to support the Synaptics RMI4 bus.  This is
	  required for all RMI4 device support.

	  If unsure, say Y.

	  This feature is not currently available as a loadable module.

config RMI4_DEBUG
	bool "RMI4 Debugging"
	depends on RMI4_CORE
	select DEBUG_FS
	help
	  Say Y here to enable debug feature in the RMI4 driver.

	  Note that the RMI4 driver debug features can generate a lot of
	  output (potentially clogging up your dmesg output) and generally
	  slow down driver operation.  It's recommended to enable them only
	  if you are actively developing/debugging RMI4 features.

	  If unsure, say N.

config RMI4_I2C
	tristate "RMI4 I2C Support"
	depends on RMI4_CORE && I2C
	help
	  Say Y here if you want to support RMI4 devices connected to an I2C
	  bus.

	  If unsure, say Y.

	  This feature is not currently available as a loadable module.

config RMI4_SPI
	tristate "RMI4 SPI Support"
	depends on RMI4_CORE && SPI
	help
	  Say Y here if you want to support RMI4 devices connected to a SPI
	  bus.

	  If unsure, say N.

config RMI4_2D_SENSOR
	bool "RMI4 2D Sensors"
	depends on RMI4_CORE
	default y if RMI4_CORE
	help
	  Say Y here if you want to add support for 2D Sensors.

	  Provides core functionality for 2D multifinger pointing for
	  touchscreens and touchpads using RMI4 functions 11 and 12. This
	  feature is needed is the device contains either F11 or F12.

config RMI4_F11
	bool "RMI4 Function 11 (2D pointing)"
	depends on RMI4_CORE
	help
	  Say Y here if you want to add support for RMI4 function 11.

	  Function 11 provides 2D multifinger pointing for touchscreens and
	  touchpads.  For sensors that support relative pointing, F11 also
	  provides mouse input.

config RMI4_F11_PEN
	bool "RMI4 F11 Pen Support"
	depends on RMI4_F11
	help
	  Say Y here to add support for pen input to RMI4 function 11.

	  If this feature is enabled, when pen inputs are detected they
	  will be reported to the input stream as MT_TOOL_PEN.  Otherwise,
	  pens will be treated the same as fingers.

	  Not all UI implementations deal gracefully with pen discrimination.
	  If your system is not recognizing pen touches and you know your
	  sensor supports pen input, you probably want to turn this feature
	  off.
```
