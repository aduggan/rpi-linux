/dts-v1/;
/plugin/;

/ {
	compatible = "brcm,bcm2835", "brcm,bcm2708", "brcm,bcm2709";

	fragment@0 {
		target = <&i2c1>;
		__overlay__ {
			status = "okay";

			i2c-hid-dev@2c {
				compatible = "hid-over-i2c";
				reg = <0x2c>;
				hid-descr-addr = <0x0020>;
				interrupt-parent = <&gpio>;
				interrupts = <4 2>;
			};
		};
	};
};
